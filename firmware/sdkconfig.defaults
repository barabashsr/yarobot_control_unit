## firmware/sdkconfig.defaults
```kconfig
# ESP32-S3 N16R8 Configuration for YaRobot Control Unit
# Story 1.1 - ESP-IDF Project Initialization

# Flash Configuration (16MB)
CONFIG_ESPTOOLPY_FLASHSIZE_16MB=y

# PSRAM Configuration (8MB Octal)
CONFIG_SPIRAM=y
CONFIG_SPIRAM_MODE_OCT=y

# FreeRTOS Configuration (1ms tick)
CONFIG_FREERTOS_HZ=1000

# Console via USB Serial JTAG (built-in, doesn't need TinyUSB enumeration)
CONFIG_ESP_CONSOLE_USB_SERIAL_JTAG=y

# CPU Frequency (240 MHz)
CONFIG_ESP_DEFAULT_CPU_FREQ_MHZ_240=y

# Custom Partition Table
CONFIG_PARTITION_TABLE_CUSTOM=y
CONFIG_PARTITION_TABLE_CUSTOM_FILENAME="partitions.csv"

# Stack overflow checking - enable watchpoint at end of stack
CONFIG_FREERTOS_WATCHPOINT_END_OF_STACK=y

# Increase panic handler delay to see crash info
CONFIG_ESP_SYSTEM_PANIC_REBOOT_DELAY_SECONDS=5

# =========================================================================
# TinyUSB CDC Configuration (Story 2.1 - USB CDC Serial Interface)
# =========================================================================
# Enable TinyUSB device stack
CONFIG_TINYUSB=y
CONFIG_TINYUSB_CDC_ENABLED=y
CONFIG_TINYUSB_CDC_COUNT=1
CONFIG_TINYUSB_CDC_RX_BUFSIZE=256
CONFIG_TINYUSB_CDC_TX_BUFSIZE=256
```
